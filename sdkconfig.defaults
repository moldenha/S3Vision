## sdkconfig.defaults
```kconfig
CONFIG_BLINK_LED_STRIP=y
#
# Please Note:
# ESP32-S3-DevKitC v1.1 uses GPIO38 for the on-board LED
# ESP32-S3-DevKitC v1.0 uses GPIO48 for the on-board LED
#
# This is important:
# It allows filenames of more than 8 characters with an extension of 3 characters
# (this enables frame counting, and time stamps embedded into the filename)
CONFIG_BT_ENABLED=n
CONFIG_ESP32_WIFI_ENABLED=n
CONFIG_ESP_WIFI_ENABLED=n
# CONFIG_LOG_DEFAULT_LEVEL_NONE=y
CONFIG_FREERTOS_USE_TRACE_FACILITY=n
CONFIG_FREERTOS_GENERATE_RUN_TIME_STATS=n
CONFIG_FATFS_LFN_HEAP=y
CONFIG_FATFS_MAX_LFN=255
CONFIG_BLINK_GPIO=38
CONFIG_FREERTOS_USE_TICKLESS_IDLE=1
CONFIG_FREERTOS_IDLE_TIME_BEFORE_SLEEP=3
```
